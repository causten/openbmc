## meta-ibm/meta-palmetto/conf/machine/palmetto.conf
```bitbake
#@TYPE: Machine
#@NAME: Palmetto
#@DESCRIPTION: Machine configuration for OpenPOWER Palmetto

UBOOT_MACHINE_palmetto = "palmetto_config"

require conf/machine/include/ast1250.inc
```
